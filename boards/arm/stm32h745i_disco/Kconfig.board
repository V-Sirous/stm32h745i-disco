## boards/arm/stm32h745i_disco/Kconfig.board
```kconfig
# STM32H745I Discovery board configuration

# Copyright (c) 2019 Linaro Limited
# SPDX-License-Identifier: Apache-2.0

config BOARD_STM32H745I_DISCO_M7
	bool "STM32H745I Discovery Development Board"
	depends on SOC_STM32H745XX
	select CPU_CORTEX_M7

config BOARD_STM32H745I_DISCO_M4
	bool "STM32H745I Discovery Development Board"
	depends on SOC_STM32H745XX
	select CPU_CORTEX_M4
```

## boards/arm/stm32h745i_disco/Kconfig.defconfig
```kconfig
# STM32H745I DISCOVERY board configuration

# Copyright (c) 2019 Linaro Limited
# SPDX-License-Identifier: Apache-2.0

if BOARD_STM32H745I_DISCO_M7 || BOARD_STM32H745I_DISCO_M4

config BOARD
	default "stm32h745i_disco_m7" if BOARD_STM32H745I_DISCO_M7
	default "stm32h745i_disco_m4" if BOARD_STM32H745I_DISCO_M4

if NETWORKING

config NET_L2_ETHERNET
	default y

endif # NETWORKING

config DISK_DRIVER_SDMMC
	default y if DISK_DRIVERS

endif # BOARD_STM32H745I_DISCO_M7
```
